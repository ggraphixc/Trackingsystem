## CMakeLists.txt
```
cmake_minimum_required(VERSION 3.20.0)

find_package(Zephyr REQUIRED HINTS $ENV{ZEPHYR_BASE})
project(dravex_tag)

target_sources(app PRIVATE
	src/main.c
	src/tag_rotation.c
	src/tag_batt.c
	src/tag_test.c
)
```

## Kconfig
```
# Dravex Tag V2 — production-oriented configuration.
# Production mode is the default: test mode (CONFIG_DRAVEX_TAG_TEST_MODE)
# is off and can only be enabled deliberately for bench work.

menu "Dravex Tag"

config DRAVEX_TAG_ADV_BURST_MS
	int "Advertising burst duration (ms) per duty cycle"
	default 0
	help
	  How long the radio advertises per cycle while armed. 0 = use the
	  built-in default in tag_config.h (250 ms). Centralized here and in
	  tag_config.h so power tuning is one place.

config DRAVEX_TAG_SLEEP_MS
	int "Deep-sleep duration (ms) between advertising bursts"
	default 0
	help
	  0 = use the built-in default in tag_config.h (5000 ms). While
	  disarmed the tag sleeps indefinitely (wake on button), so this only
	  matters in the armed duty cycle.

config DRAVEX_TAG_ADV_INT_MIN_MS
	int "Advertising interval minimum (ms)"
	default 0
	help
	  Lower bound of the advertising interval range in milliseconds
	  (0 = tag_config.h default 100 ms).

config DRAVEX_TAG_ADV_INT_MAX_MS
	int "Advertising interval maximum (ms)"
	default 0
	help
	  Upper bound of the advertising interval range in milliseconds
	  (0 = tag_config.h default 150 ms).

config DRAVEX_TAG_TEST_MODE
	bool "Hardware test mode (bench only — never for production)"
	default n
	help
	  Enables bench features: identity/battery logging over the debug
	  UART, an immediate beacon rotation, and timing overrides. It NEVER
	  changes what is broadcast beyond the still-day-derived beacon, and
	  it NEVER exposes the permanent secret over BLE. Production builds
	  must leave this off.

config DRAVEX_TAG_TEST_DAY_OFFSET
	int "Test mode: day offset applied to the rotation bucket"
	default 1
	depends on DRAVEX_TAG_TEST_MODE
	help
	  Forces the beacon to a different rotation bucket immediately so the
	  bench can watch it change. The result intentionally does not
	  resolve on the live server (it is a future day) — it proves the
	  rotation mechanics.

config DRAVEX_TAG_TEST_BURST_MS
	int "Test mode: advertising burst override (ms, 0 = production value)"
	default 0
	depends on DRAVEX_TAG_TEST_MODE

config DRAVEX_TAG_TEST_SLEEP_MS
	int "Test mode: deep-sleep override (ms, 0 = production value)"
	default 0
	depends on DRAVEX_TAG_TEST_MODE

endmenu
```

## prj.conf
```kconfig
# Dravex Tag V2 — recovery beacon (nRF52840)

# --- Bluetooth LE peripheral with extended advertising ----------------
# The 43-byte packet (UUID128 + service data) does not fit legacy adv.
CONFIG_BT=y
CONFIG_BT_PERIPHERAL=y
CONFIG_BT_EXT_ADV=y
CONFIG_BT_DEVICE_NAME="Dravex-Tag"
# Controller TX power is centralized here (0 dBm default on nRF52840).
# Tune for range vs battery: e.g. CONFIG_BT_CTLR_TX_PWR_MINUS_8DBM.

# --- Persistent identity: NVS secret survives reboots + battery swaps ---
CONFIG_SETTINGS=y
CONFIG_SETTINGS_NVS=y
CONFIG_NVS=y

# --- Day-rotated beacon: sha256 derivation ----------------------------
CONFIG_TINYCRYPT=y
CONFIG_TINYCRYPT_SHA256=y

# --- Low power: STANDBY between bursts (RTC keeps running, ~1 uA) ------
CONFIG_PM=y
# ADC for battery sense on boards that wire the batt_vbat alias.
CONFIG_ADC=y

# --- Random secret generation on first boot ----------------------------
CONFIG_ENTROPY_GENERATOR=y
CONFIG_RANDOM_GENERATOR=y

# --- Button + LED -------------------------------------------------------
CONFIG_GPIO=y

# --- Logging (prints the tag id on boot) -------------------------------
CONFIG_LOG=y
CONFIG_LOG_DEFAULT_LEVEL=3

# --- Test mode: OFF by default (production default). --------------------
# Enable only for bench work: CONFIG_DRAVEX_TAG_TEST_MODE=y in a .conf
# overlay (e.g. prj_test.conf) — never in a production build.
```

## src/main.c
```c
/*
 * Dravex Tag V2 — production recovery beacon firmware (Zephyr / nRF52840).
 *
 * Broadcasts the SAME Dravex beacon format as the Android agent (service
 * UUID 0000fffa-0000-1000-8000-00805f9b34fb, service data = [0x01] + 12 hex
 * chars), so every existing Dravex phone/desktop scanner already hears it —
 * zero protocol changes.
 *
 * V2 vs the prototype:
 *   - The permanent identity (6 bytes, NVS) is NEVER broadcast. What the
 *     tag advertises is a day-rotated beacon derived from that secret
 *     (tag_rotation.c) — no permanent BLE tracking identifier.
 *   - Time-aware rotation needs a battery-backed RTC (devicetree alias
 *     `drax_rtc`). Without one the tag FAILS CLOSED: it refuses to advertise
 *     and signals ERROR instead of inventing time (DRAVEX_NEXTGENE §19).
 *   - Duty cycle: SLEEP → WAKE → ADVERTISE(burst) → SLEEP, driven by a
 *     dedicated thread with the CPU parked in STANDBY between bursts
 *     (tag_config.h holds every timing knob in one place).
 *   - Button: short press = status pulse; long press (>= 2 s) = arm/disarm.
 *     The tag is DISARMED / QUIET by default — it advertises only while
 *     armed, and a reboot re-arms nothing (fail-safe).
 *   - Battery telemetry (tag_batt.c) is measured only on boards that wire
 *     the `batt_vbat` ADC alias; otherwise honestly UNKNOWN.
 *   - Test mode (CONFIG_DRAVEX_TAG_TEST_MODE, default n) is a bench-only
 *     feature; it never changes the BLE privacy model.
 *
 * Build:  west build -b nrf52840dk_nrf52840 tag-firmware
 *         west flash
 */

#include <zephyr/kernel.h>
#include <zephyr/device.h>
#include <zephyr/drivers/gpio.h>
#include <zephyr/bluetooth/bluetooth.h>
#include <zephyr/bluetooth/adv.h>
#include <zephyr/settings/settings.h>
#include <zephyr/random/rand32.h>
#include <zephyr/logging/log.h>
#include <zephyr/sys/util.h> /* ARRAY_SIZE, BIT, IS_ENABLED */
#include <string.h>

#if defined(CONFIG_PM)
#include <zephyr/pm/pm.h>
#include <zephyr/pm/state.h>
#endif

#include "tag_rotation.h"
#include "tag_batt.h"
#include "tag_config.h"
#include "tag_test.h"

LOG_MODULE_REGISTER(dravex_tag, LOG_LEVEL_INF);

/* ---------------- identity (persistent, never broadcast) ---------------- */

#define TAG_ID_BYTES 6
#define TAG_ID_HEX_LEN 12

static uint8_t tag_id[TAG_ID_BYTES];
static char tag_id_hex[TAG_ID_HEX_LEN + 1];
static bool id_loaded;

static const char hex_chars[] = "0123456789abcdef";

static int settings_load_id(const char *key, size_t len,
			    settings_read_cb read_cb, void *cb_arg)
{
	if (!strcmp(key, "id")) {
		if (len != TAG_ID_BYTES) {
			return -EINVAL;
		}
		ssize_t n = read_cb(cb_arg, tag_id, TAG_ID_BYTES);
		if (n == TAG_ID_BYTES) {
			id_loaded = true;
			return 0;
		}
		return -EINVAL;
	}
	return 0;
}

SETTINGS_STATIC_HANDLER_DEFINE(tag, "tag", NULL, settings_load_id, NULL, NULL);

static void hex_encode(void)
{
	for (int i = 0; i < TAG_ID_BYTES; i++) {
		tag_id_hex[i * 2] = hex_chars[tag_id[i] >> 4];
		tag_id_hex[i * 2 + 1] = hex_chars[tag_id[i] & 0x0f];
	}
	tag_id_hex[TAG_ID_HEX_LEN] = '\0';
}

static void load_or_create_id(void)
{
	settings_load();

	if (!id_loaded) {
		sys_rand_get(tag_id, sizeof(tag_id));
		settings_save_one("tag/id", tag_id, sizeof(tag_id));
		LOG_INF("Generated new tag id");
	}
	hex_encode();
}

/* ---------------- advertising (extended, day-rotated beacon) -------------- */

#define BT_UUID_DRAVEX_SVC 0xfffa

static const struct bt_uuid_128 dravex_uuid =
	BT_UUID_128_INIT(BT_UUID_128_ENCODE(0x0000fffa, 0x00001000, 0x80000080,
					    0x5f9b34fb));

static uint8_t svc_data[13]; /* [0x01] + 12 hex chars */
static struct bt_data adv_data[2];
static struct bt_le_ext_adv *adv_set;

static struct tag_timing timing;

/* Convert a central timing (ms) into the BLE 0.625 ms unit. */
#define MS_TO_BT(x) ((x) * 8u)

static void build_adv_data(const char *beacon_hex)
{
	svc_data[0] = 0x01; /* beacon version 1 — matches Beacon.kt */
	memcpy(&svc_data[1], beacon_hex, TAG_BEACON_HEX_LEN);

	adv_data[0] = (struct bt_data)BT_DATA(BT_DATA_UUID128_ALL,
					      dravex_uuid.val, 16);
	adv_data[1] = (struct bt_data)BT_DATA(BT_DATA_SVC_DATA128, svc_data,
					      sizeof(svc_data));
}

static int adv_init(void)
{
	int err;

	err = bt_le_ext_adv_create(NULL, NULL, &adv_set);
	if (err) {
		LOG_ERR("adv create failed: %d", err);
		return err;
	}
	return 0;
}

/* ---------------- LED status (short pulses — battery friendly) ------------ */

static const struct gpio_dt_spec led = GPIO_DT_SPEC_GET(DT_ALIAS(led0), gpios);
static const struct gpio_dt_spec btn = GPIO_DT_SPEC_GET(DT_ALIAS(btn0), gpios);

static void led_on(void)
{
	if (gpio_is_ready_dt(&led)) {
		gpio_pin_set_dt(&led, 1);
	}
}

static void led_off(void)
{
	if (gpio_is_ready_dt(&led)) {
		gpio_pin_set_dt(&led, 0);
	}
}

/* Short blocking pulse train — used only from the button work item. */
static void led_pulse(int pulses, int ms_on, int ms_gap)
{
	for (int i = 0; i < pulses; i++) {
		led_on();
		k_msleep(ms_on);
		led_off();
		if (i + 1 < pulses) {
			k_msleep(ms_gap);
		}
	}
}

static void led_status(bool now_armed, const struct tag_batt_state *batt)
{
	/* armed: 2 quick pulses · disarmed: 1 · +1 slow pulse when low. */
	int pulses = now_armed ? 2 : 1;
	int tail = (batt && batt->low) ? 1 : 0;

	led_pulse(pulses, 60, 120);
	if (tail) {
		k_msleep(200);
		led_pulse(1, 400, 0);
	}
}

static void led_error(void)
{
	led_pulse(4, 150, 150);
}

/* ---------------- armed state + duty cycle ---------------- */

static bool armed;

static struct k_sem armed_sem;

static void set_armed(bool on)
{
	if (on == armed) {
		return;
	}
	armed = on;
	if (on) {
		k_sem_give(&armed_sem);
		LOG_INF("ARMED — broadcasting day-rotated beacon");
	} else {
		(void)bt_le_ext_adv_stop(adv_set);
		led_off();
		LOG_INF("disarmed — silent");
	}
}

/*
 * Dedicated thread: SLEEP → WAKE → ADVERTISE(burst) → SLEEP. The beacon is
 * re-derived every cycle, so the id rotates automatically at the UTC day
 * boundary while armed. Between bursts the CPU is parked in STANDBY (RTC
 * keeps running, so the kernel timer wakes it; the nRF52840 draws ~1 µA).
 */
K_THREAD_STACK_DEFINE(adv_stack, 1024);
static struct k_thread adv_thread_data;

static void adv_cycle_entry(void *a, void *b, void *c)
{
	(void)a;
	(void)b;
	(void)c;

	for (;;) {
		if (!armed) {
			k_sem_take(&armed_sem, K_FOREVER);
			continue;
		}

		uint32_t day = 0;
		int err = tag_rotation_epoch_day(&day);

		if (err != 0) {
			/* No RTC → fail closed: never broadcast a wrong id. */
			LOG_ERR("no time source — cannot rotate beacon safely");
			set_armed(false);
			led_error();
			continue;
		}
		/* Test mode may force an immediate rotation (bench only). */
		day += tag_test_day_offset();

		char beacon_hex[TAG_BEACON_HEX_BUF];
		tag_rotation_derive(tag_id_hex, day, beacon_hex);
		build_adv_data(beacon_hex);
		(void)bt_le_ext_adv_set_data(adv_set, adv_data,
					     ARRAY_SIZE(adv_data), NULL, 0);

		(void)bt_le_ext_adv_start(adv_set, BT_LE_EXT_ADV_START_DEFAULT);
		led_on(); /* visible with the burst — a soft blink, not a strobe */
		k_sleep(K_MSEC(timing.adv_burst_ms));
		(void)bt_le_ext_adv_stop(adv_set);
		led_off();

		/* Park in STANDBY until the next burst (kernel timer wakes us). */
		k_sleep(K_MSEC(timing.sleep_ms));
	}
}

/* ---------------- button (short = status, long = arm/disarm) -------------- */

static struct k_work_delayable debounce_work;
static struct gpio_callback btn_cb;
static bool btn_down;
static int64_t press_start_ms;

#define PRESS_SHORT_MAX_MS 1000
#define PRESS_LONG_MIN_MS 2000

static bool pressed_now(void); /* fwd — defined below with the GPIO block */

static void debounce_fn(struct k_work *work)
{
	bool down = pressed_now();

	if (down == btn_down) {
		return;
	}
	btn_down = down;
	if (down) {
		press_start_ms = k_uptime_get();
	} else {
		int64_t held_ms = k_uptime_get() - press_start_ms;
		struct tag_batt_state batt;

		tag_batt_read(&batt); /* may be UNKNOWN — led_status handles it */
		if (held_ms >= PRESS_LONG_MIN_MS) {
			set_armed(!armed);
			/* Feedback after toggling: 2 pulses if armed, 1 if not. */
			led_status(armed, &batt);
		} else if (held_ms < PRESS_SHORT_MAX_MS) {
			LOG_INF("status: armed=%d batt_mv=%d pct=%d low=%d",
				armed ? 1 : 0, batt.mv, batt.percent,
				batt.low ? 1 : 0);
			led_status(armed, &batt);
		}
	}
}

static bool pressed_now(void)
{
	/* nRF52840 DK buttons are active-low (pulled up, pressed = 0). */
	return gpio_pin_get_dt(&btn) == 0;
}

static void btn_isr(const struct device *dev, struct gpio_callback *cb,
		    uint32_t pins)
{
	k_work_schedule(&debounce_work, K_MSEC(50));
}

static void setup_gpio(void)
{
	int err;

	if (!gpio_is_ready_dt(&btn)) {
		LOG_WRN("button not ready");
		return;
	}
	err = gpio_pin_configure_dt(&btn, GPIO_INPUT | GPIO_PULL_UP);
	if (err) {
		LOG_ERR("button config failed: %d", err);
		return;
	}
	gpio_init_callback(&btn_cb, btn_isr, BIT(btn.pin));
	err = gpio_add_callback(btn.port, &btn_cb);
	if (err) {
		LOG_ERR("button callback failed: %d", err);
		return;
	}
	err = gpio_pin_interrupt_configure_dt(&btn, GPIO_INT_EDGE_BOTH);
	if (err) {
		LOG_ERR("button irq failed: %d", err);
		return;
	}
	k_work_init_delayable(&debounce_work, debounce_fn);

	if (gpio_is_ready_dt(&led)) {
		gpio_pin_configure_dt(&led, GPIO_OUTPUT_INACTIVE);
	}
}

/* ---------------- main ---------------- */

void main(void)
{
	int err;

	LOG_INF("Dravex Tag V2 starting");

	err = bt_enable(NULL);
	if (err) {
		LOG_ERR("BT init failed: %d", err);
		return;
	}

	load_or_create_id();
	timing = tag_timing_get();

	err = adv_init();
	if (err) {
		return;
	}

	/* One-time check: warn loudly when the board has no RTC time source. */
	uint32_t day = 0;
	if (tag_rotation_epoch_day(&day) != 0) {
		LOG_WRN("no RTC time source — arming will fail closed (see "
			"DRAVEX_NEXTGENE §19 / DRAVEX_TAG_V2.md)");
	}

#if defined(CONFIG_PM)
	/* Park idle time in STANDBY: RTC stays alive so k_sleep timers fire. */
	pm_state_force(0, &(struct pm_state_info){ PM_STATE_STANDBY });
#endif

	setup_gpio();

	k_sem_init(&armed_sem, 0, 1);
	k_thread_create(&adv_thread_data, adv_stack, K_THREAD_STACK_SIZEOF(adv_stack),
			adv_cycle_entry, NULL, NULL, NULL,
			K_PRIO_PREEMPT(7), 0, K_NO_WAIT);
	k_thread_name_set(&adv_thread_data, "adv_cycle");

	struct tag_batt_state batt;
	tag_batt_read(&batt);

	/* Default state: DISARMED / QUIET. A reboot never re-arms (fail-safe). */
	armed = false;

	tag_test_log_boot(tag_id_hex, &batt, armed);

	LOG_INF("Ready — tag %s. Short press: status. Long press (>= 2 s): "
		"arm/disarm. Default: disarmed (silent).",
		tag_id_hex);
}
```

## src/tag_batt.c
```c
/*
 * Dravex Tag V2 — battery telemetry (implementation).
 *
 * A CR2032 cell through a resistor divider on an ADC channel. The board
 * overlay wires the sense pin as devicetree alias `batt_vbat`; without it
 * (nRF52840 DK prototype) the state is TAG_BATT_UNKNOWN and `low` stays
 * false — no fabricated numbers.
 *
 * The percentage is a coarse linear estimate over the CR2032's usable range
 * (~3.0–2.0 V under load). It is an ESTIMATE, not a measured discharge
 * curve — the README says so, and production calibration requires real
 * hardware testing.
 */

#include <zephyr/kernel.h>
#include <zephyr/device.h>
#include <zephyr/drivers/adc.h>
#include <string.h>

#include "tag_batt.h"

#if DT_NODE_EXISTS(DT_ALIAS(batt_vbat))
#define TAG_HAS_BATT 1
#else
#define TAG_HAS_BATT 0
#endif

/* CR2032 estimate: 3.0 V full … 2.0 V flat. Adjust with real hardware. */
#define TAG_BATT_FULL_MV 3000
#define TAG_BATT_FLAT_MV 2000
#define TAG_BATT_LOW_MV 2300

#if TAG_HAS_BATT
static const struct adc_dt_spec batt =
	ADC_DT_SPEC_GET(DT_ALIAS(batt_vbat));
#endif

void tag_batt_read(struct tag_batt_state *out)
{
	memset(out, 0, sizeof(*out));
	out->mv = TAG_BATT_UNKNOWN;
	out->percent = TAG_BATT_UNKNOWN;

#if TAG_HAS_BATT
	int16_t sample = 0;
	int err;

	if (!device_is_ready(batt.dev)) {
		return;
	}
	err = adc_channel_setup_dt(&batt);
	if (err != 0) {
		return;
	}
	err = adc_read_dt(&batt, &sample);
	if (err != 0) {
		return;
	}
	/* adc_raw_to_millivolts handles the gain/reference configured in dts. */
	int32_t mv;
	err = adc_raw_to_millivolts_dt(&batt, &sample, &mv);
	if (err != 0) {
		return;
	}
	out->mv = mv;
	if (mv <= TAG_BATT_FULL_MV) {
		int32_t span = TAG_BATT_FULL_MV - TAG_BATT_FLAT_MV;
		int32_t pct = (mv - TAG_BATT_FLAT_MV) * 100 / span;
		out->percent = pct < 0 ? 0 : (pct > 100 ? 100 : pct);
	}
	out->low = mv <= TAG_BATT_LOW_MV;
#endif
}
```

## src/tag_batt.h
```c
/*
 * Dravex Tag V2 — battery telemetry.
 *
 * Measured ONLY when the board provides a battery sense node wired as the
 * devicetree alias `batt_vbat` (an ADC channel through a resistor divider to
 * the coin cell). On boards without it (the nRF52840 DK prototype has no
 * battery input) every call reports TAG_BATT_UNKNOWN — the firmware never
 * fabricates a voltage or percentage.
 */

#ifndef TAG_BATT_H
#define TAG_BATT_H

#include <stdint.h>

#define TAG_BATT_UNKNOWN -1

struct tag_batt_state {
	/** Millivolts, or TAG_BATT_UNKNOWN when not measurable. */
	int32_t mv;
	/** 0–100, or TAG_BATT_UNKNOWN. */
	int32_t percent;
	/** True only when mv is measurable and below the low threshold. */
	bool low;
};

/** Read the battery once. Callers should rate-limit (ADC draws current). */
void tag_batt_read(struct tag_batt_state *out);

#endif /* TAG_BATT_H */
```

## src/tag_config.h
```c
/*
 * Dravex Tag V2 — centralized timing / power configuration.
 *
 * All duty-cycle and advertising knobs live here (or in Kconfig behind the
 * same symbols) so a firmware tuning pass touches exactly one place. Values
 * are DEFAULTS; production tuning must be validated on real hardware.
 *
 * Battery-life figures below are ESTIMATES (typical CR2032 ≈ 220 mAh):
 * they are not measured and must not be quoted as product claims until
 * bench-tested.
 */

#ifndef TAG_CONFIG_H
#define TAG_CONFIG_H

#include <stdint.h>

/* Kconfig-backed defaults (see Kconfig). 0 means "use the built-in default". */
#ifndef CONFIG_DRAVEX_TAG_ADV_BURST_MS
#define CONFIG_DRAVEX_TAG_ADV_BURST_MS 0
#endif
#ifndef CONFIG_DRAVEX_TAG_SLEEP_MS
#define CONFIG_DRAVEX_TAG_SLEEP_MS 0
#endif
#ifndef CONFIG_DRAVEX_TAG_ADV_INT_MIN_MS
#define CONFIG_DRAVEX_TAG_ADV_INT_MIN_MS 0
#endif
#ifndef CONFIG_DRAVEX_TAG_ADV_INT_MAX_MS
#define CONFIG_DRAVEX_TAG_ADV_INT_MAX_MS 0
#endif

struct tag_timing {
	/** ms the radio advertises per cycle before sleeping. */
	uint32_t adv_burst_ms;
	/** ms of deep sleep between bursts. */
	uint32_t sleep_ms;
	/** Advertising interval range (ms) — 0.625 ms units at the BLE layer. */
	uint32_t adv_int_min_ms;
	uint32_t adv_int_max_ms;
	/**
	 * Controller TX power (dBm) — informational. The actual power is set
	 * by the BLE controller Kconfig (e.g. CONFIG_BT_CTLR_TX_PWR_*), kept
	 * in prj.conf so power tuning is also centralized.
	 */
	int8_t tx_power_dbm;
};

/*
 * Built-in defaults (used when the matching Kconfig is 0).
 *
 *   burst 250 ms → sleep 5 s  ≈ 5% radio duty while armed.
 *   advertising 100 ms–150 ms (fast discovery burst).
 *
 * Armed battery estimate: a 5% duty burst on a CR2032 is on the order of
 * WEEKS, not days — but this is an estimate; real drain (radio + RTC +
 * regulator + LED) must be measured on the bench before quoting numbers.
 * Disarmed the tag sleeps deeply and draws only leakage (RTC + system-off
 * quiescent), which is the point: the tag is quiet until armed.
 */
#define TAG_TIMING_DEFAULT_BURST_MS 250u
#define TAG_TIMING_DEFAULT_SLEEP_MS 5000u
#define TAG_TIMING_DEFAULT_ADV_INT_MIN_MS 100u
#define TAG_TIMING_DEFAULT_ADV_INT_MAX_MS 150u
#define TAG_TIMING_DEFAULT_TX_POWER_DBM 0

/** Resolve the effective timing: Kconfig override, else the defaults. */
static inline struct tag_timing tag_timing_get(void)
{
	struct tag_timing t;

	t.adv_burst_ms = CONFIG_DRAVEX_TAG_ADV_BURST_MS
				 ? CONFIG_DRAVEX_TAG_ADV_BURST_MS
				 : TAG_TIMING_DEFAULT_BURST_MS;
	t.sleep_ms = CONFIG_DRAVEX_TAG_SLEEP_MS
			     ? CONFIG_DRAVEX_TAG_SLEEP_MS
			     : TAG_TIMING_DEFAULT_SLEEP_MS;
	t.adv_int_min_ms = CONFIG_DRAVEX_TAG_ADV_INT_MIN_MS
				   ? CONFIG_DRAVEX_TAG_ADV_INT_MIN_MS
				   : TAG_TIMING_DEFAULT_ADV_INT_MIN_MS;
	t.adv_int_max_ms = CONFIG_DRAVEX_TAG_ADV_INT_MAX_MS
				   ? CONFIG_DRAVEX_TAG_ADV_INT_MAX_MS
				   : TAG_TIMING_DEFAULT_ADV_INT_MAX_MS;
	t.tx_power_dbm = TAG_TIMING_DEFAULT_TX_POWER_DBM;

	/* Test-mode timing overrides (bench only). */
#if defined(CONFIG_DRAVEX_TAG_TEST_MODE) && CONFIG_DRAVEX_TAG_TEST_MODE
	if (CONFIG_DRAVEX_TAG_TEST_BURST_MS > 0) {
		t.adv_burst_ms = CONFIG_DRAVEX_TAG_TEST_BURST_MS;
	}
	if (CONFIG_DRAVEX_TAG_TEST_SLEEP_MS > 0) {
		t.sleep_ms = CONFIG_DRAVEX_TAG_TEST_SLEEP_MS;
	}
#endif

	return t;
}

#endif /* TAG_CONFIG_H */
```

## src/tag_rotation.c
```c
/*
 * Dravex Tag V2 — time-aware beacon rotation (implementation).
 *
 * Rotation scheme (documented in DRAVEX_NEXTGENE.md §19):
 *
 *   epoch_day  = floor(now_utc / 86400)
 *   beacon     = hex(sha256(secret_hex + "|" + epoch_day))[0..12]
 *
 * `secret_hex` is the tag's permanent 12-hex NVS identity — it is NEVER
 * transmitted over BLE; only the rotated beacon is broadcast, and it changes
 * at every UTC day boundary. The server tries today + yesterday, so a valid
 * beacon resolves and yesterday's expires naturally.
 *
 * Time: absolute epoch-day comes from an RTC (devicetree alias `drax_rtc`)
 * using the Zephyr `rtc_get_time` API. When no RTC is present,
 * tag_rotation_epoch_day() returns -ENOTSUP and the tag fails CLOSED (quiet
 * + error LED) — it never invents time and never falls back to a permanent
 * broadcast id.
 */

#include <zephyr/kernel.h>
#include <zephyr/settings/settings.h>
#include <tinycrypt/sha256.h>
#include <string.h>

#include "tag_rotation.h"

/* Only when the board overlay wires an RTC and RTC support is enabled. */
#if defined(CONFIG_RTC) && DT_NODE_EXISTS(DT_ALIAS(drax_rtc))
#include <zephyr/drivers/rtc.h>
#define TAG_HAS_RTC 1
#else
#define TAG_HAS_RTC 0
#endif

static const char hex_chars[] = "0123456789abcdef";

int tag_rotation_epoch_day(uint32_t *day_out)
{
#if TAG_HAS_RTC
	const struct device *rtc_dev = DEVICE_DT_GET(DT_ALIAS(drax_rtc));
	struct rtc_time tm;

	if (!device_is_ready(rtc_dev)) {
		return -ENODEV;
	}
	if (rtc_get_time(rtc_dev, &tm) != 0) {
		return -EIO;
	}
	/*
	 * Days since the Unix epoch from a civil date (Howard Hinnant's
	 * days_from_civil). The server's dayBucket() uses the same UTC epoch
	 * day, so the tag and the server always land on the same boundary.
	 */
	int32_t y = (int32_t)tm.tm_year;
	int32_t m = (int32_t)tm.tm_mon + 1; /* Zephyr rtc_time is 0-based */
	int32_t d = (int32_t)tm.tm_mday;
	y -= (m <= 2);
	const int32_t era = (y >= 0 ? y : y - 399) / 400;
	const unsigned int yoe = (unsigned int)(y - era * 400);
	const unsigned int doy = (153 * (m + (m > 2 ? -3 : 9)) + 2) / 5 + d - 1;
	const unsigned int doe = yoe * 365 + yoe / 4 - yoe / 100 + doy;
	*day_out = (uint32_t)(era * 146097 + (int32_t)doe - 719468);
	return 0;
#else
	(void)day_out;
	return -ENOTSUP;
#endif
}

void tag_rotation_derive(const char *secret_hex, uint32_t day,
			 char *beacon_hex_out)
{
	struct tc_sha256_state_struct ctx;
	uint8_t digest[32];
	char input[16 + 1 + 10 + 1]; /* 12-hex secret + "|" + day (max 10 digits) */

	snprintk(input, sizeof(input), "%s|%u", secret_hex, (unsigned int)day);

	(void)tc_sha256_init(&ctx);
	(void)tc_sha256_update(&ctx, (const uint8_t *)input, strlen(input));
	(void)tc_sha256_final(digest, &ctx);

	for (int i = 0; i < TAG_BEACON_HEX_LEN / 2; i++) {
		beacon_hex_out[i * 2] = hex_chars[digest[i] >> 4];
		beacon_hex_out[i * 2 + 1] = hex_chars[digest[i] & 0x0f];
	}
	beacon_hex_out[TAG_BEACON_HEX_LEN] = '\0';
}
```

## src/tag_rotation.h
```c
/*
 * Dravex Tag V2 — time-aware beacon rotation.
 *
 * The tag NEVER broadcasts its permanent identity (the 6-byte NVS secret).
 * Instead it broadcasts a day-rotated beacon:
 *
 *   beacon = hex(sha256(secret_hex + "|" + epoch_day))[0..12]
 *
 * which is the same derivation family as the Android agent
 * (server/beacon.js: beaconFor(deviceId, dayBucket)), keyed on the tag's
 * permanent secret instead of the deviceId. The server resolves it by
 * trying today and yesterday for every device that carries a staticBeacon
 * (see server/beacon.js resolveBeacon) — so a valid beacon always resolves,
 * yesterday's expires naturally, and no listener can follow the tag across
 * days or replay an old beacon.
 *
 * Time source (fail-safe by design):
 *   - An RTC wired as devicetree alias `drax_rtc` (e.g. NXP PCF85063 on I2C,
 *     battery-backed) provides the absolute epoch day via rtc_get_time().
 *   - WITHOUT an RTC the tag CANNOT know the current epoch day. It fails
 *     closed: it refuses to advertise (even when armed) and signals ERROR,
 *     rather than inventing time or broadcasting a permanent id. A
 *     production tag therefore requires a battery-backed RTC; the nRF52840
 *     DK (no RTC) demonstrates everything except rotation and is used for
 *     development/test mode.
 *
 * The rotation math is mirrored exactly by server/e2e-tag.js so the C and
 * the server can never drift apart.
 */

#ifndef TAG_ROTATION_H
#define TAG_ROTATION_H

#include <stdint.h>
#include <stddef.h>

#define TAG_BEACON_HEX_LEN 12
#define TAG_BEACON_HEX_BUF (TAG_BEACON_HEX_LEN + 1)

/**
 * Current absolute epoch day (UTC, floor(now / 86400 s)) — the rotation
 * bucket. Returns 0 and -ENOTSUP when no RTC time source is available.
 */
int tag_rotation_epoch_day(uint32_t *day_out);

/**
 * Derive the day-rotated beacon for a secret + day. `secret_hex` is the
 * 12-char lowercase hex permanent secret; `beacon_hex_out` must be at least
 * TAG_BEACON_HEX_BUF bytes. Deterministic — same secret + day → same beacon.
 */
void tag_rotation_derive(const char *secret_hex, uint32_t day,
			 char *beacon_hex_out);

#endif /* TAG_ROTATION_H */
```

## src/tag_test.c
```c
/*
 * Dravex Tag V2 — hardware test mode (implementation).
 *
 * Production mode is the default (CONFIG_DRAVEX_TAG_TEST_MODE=n). Test mode
 * is a compile-time dev/bench feature; all overrides come from Kconfig so a
 * production build can never enable them accidentally.
 */

#include <zephyr/kernel.h>
#include <zephyr/logging/log.h>

#include "tag_test.h"

LOG_MODULE_REGISTER(dravex_tag_test, LOG_LEVEL_INF);

bool tag_test_enabled(void)
{
	return IS_ENABLED(CONFIG_DRAVEX_TAG_TEST_MODE);
}

uint32_t tag_test_day_offset(void)
{
	return tag_test_enabled() ? CONFIG_DRAVEX_TAG_TEST_DAY_OFFSET : 0;
}

int32_t tag_test_burst_ms(void)
{
	return tag_test_enabled() ? CONFIG_DRAVEX_TAG_TEST_BURST_MS : 0;
}

int32_t tag_test_sleep_ms(void)
{
	return tag_test_enabled() ? CONFIG_DRAVEX_TAG_TEST_SLEEP_MS : 0;
}

void tag_test_log_boot(const char *id_hex, const struct tag_batt_state *batt,
		       bool armed)
{
	if (!tag_test_enabled()) {
		return;
	}
	LOG_INF("[test] permanent id (dev UART only, never BLE): %s",
		id_hex);
	if (batt) {
		LOG_INF("[test] battery: mv=%d pct=%d low=%d", batt->mv,
			batt->percent, batt->low ? 1 : 0);
	}
	LOG_INF("[test] armed=%d mode=%s", armed ? 1 : 0,
		IS_ENABLED(CONFIG_DRAVEX_TAG_TEST_MODE) ? "TEST" : "PROD");
}
```

## src/tag_test.h
```c
/*
 * Dravex Tag V2 — hardware test mode.
 *
 * Enabled ONLY by CONFIG_DRAVEX_TAG_TEST_MODE (default n — production mode
 * is the default). Test mode is for the bench: it logs the permanent
 * identity and battery through the DEBUG UART (the secure development
 * interface), allows an immediate beacon rotation, and overrides the duty
 * cycle timings. It NEVER changes what goes into BLE packets beyond the
 * (still day-derived) beacon, and it never exposes the permanent secret
 * over the air.
 */

#ifndef TAG_TEST_H
#define TAG_TEST_H

#include <stdint.h>
#include <stdbool.h>

#include "tag_batt.h"

/** True when CONFIG_DRAVEX_TAG_TEST_MODE is set. */
bool tag_test_enabled(void);

/**
 * Day offset applied to the rotation bucket in test mode (0 = none).
 * Lets a developer force the beacon to change immediately without waiting
 * for midnight — the resulting beacon intentionally won't resolve on the
 * live server (it is a future day); it proves the rotation mechanics.
 */
uint32_t tag_test_day_offset(void);

/** Advertising-burst override (ms); 0 = use production config. */
int32_t tag_test_burst_ms(void);

/** Deep-sleep override (ms); 0 = use production config. */
int32_t tag_test_sleep_ms(void);

/**
 * Boot diagnostics over the debug UART only: permanent identity hex,
 * battery state, armed state. Never transmitted over BLE.
 */
void tag_test_log_boot(const char *id_hex, const struct tag_batt_state *batt,
		       bool armed);

#endif /* TAG_TEST_H */
```
